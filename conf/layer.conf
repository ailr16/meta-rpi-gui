## conf/layer.conf
```bitbake
BBPATH .= ":${LAYERDIR}"

BBFILES += "${LAYERDIR}/recipes-*/*/*.bb \
  ${LAYERDIR}/recipes-*/*/*.bbappend"

BBFILE_COLLECTIONS += "rpi-gui"
BBFILE_PATTERN_rpi-gui = "^${LAYERDIR}/"
BBFILE_PRIORITY_rpi-gui = "4"

LAYERSERIES_COMPAT_rpi-gui = "nanbield"

# Raspberry Pi HW extra conf
LICENSE_FLAGS_ACCEPTED = "synaptics-killswitch"
VC4DTBO = "vc4-fkms-v3d-pi4"
ENABLE_UART = "1"
GPU_MEM = "256"
MACHINE_FEATURES += "touchscreen"

# Keep dropbear instead openssh
IMAGE_INSTALL:append = " dropbear"
IMAGE_INSTALL:remove = " openssh"

# Install tkinter
PACKAGECONFIG:append:pn-python3 = " tk"

# Install rpi gpio (related to gpiomem kernel module)
IMAGE_INSTALL:append = " rpi-gpio"

# Install touchscreen kmod
# IMAGE_INSTALL:append = " kernel-module-raspberrypi-ts"

# Install and enable systemd
# DISTRO_FEATURES:append = " systemd usrmerge"
# DISTRO_FEATURES_BACKFILL_CONSIDERED += "sysvinit"
# VIRTUAL-RUNTIME_init_manager = "systemd"
# VIRTUAL-RUNTIME_initscripts = "systemd-compat-units"
```
